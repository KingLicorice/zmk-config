## config/west.yml
```yaml
manifest:
  defaults:
    revision: v0.3
  remotes:
    - name: zmkfirmware
      url-base: https://github.com/zmkfirmware
#    - name: carrefinho
#      url-base: https://github.com/carrefinho
    - name: janpfischer
      url-base: https://github.com/janpfischer
    # Additional modules containing boards/shields/custom code can be listed here as well
    # See https://docs.zephyrproject.org/3.2.0/develop/west/manifest.html#projects
  projects:
    - name: zmk
      remote: zmkfirmware
      import: app/west.yml
    - name: zmk-dongle-screen
      remote: janpfischer
      revision: main
#    - name: prospector-zmk-module
#      remote: carrefinho
#      revision: main
  self:
    path: config
```
